## conf/layer.conf
```bitbake
# We have a conf and classes directory, add to BBPATH
BBPATH .= ":${LAYERDIR}"

# We have a recipes-* directories, add to BBFILES
BBFILES += "${LAYERDIR}/recipes-*/*/*.bb \
	${LAYERDIR}/recipes-*/*/*.bbappend"

BBFILE_COLLECTIONS += "admxrc7z"
BBFILE_PATTERN_admxrc7z = "^${LAYERDIR}/"
BBFILE_PRIORITY_admxrc7z = "6"
```

## conf/machine/admxrc7z.conf
```bitbake
#@TYPE: Machine
#@NAME: admxrc7z

#@DESCRIPTION: Machine configuration for admxrc7z systems


MACHINE_EXTRA_RRECOMMENDS = " kernel-modules kernel-devicetree"

require conf/machine/include/tune-zynq.inc
require conf/machine/include/machine-xilinx-default.inc

IMAGE_FSTYPES += "cpio.gz.u-boot"
IMAGE_CLASSES += "image_types_uboot"

SERIAL_CONSOLE = "115200 ttyPS0"

# Kernel Configuration
XILINX_DEFAULT_KERNEL := "linux-xlnx"
XILINX_DEFAULT_KERNEL_microblaze := "linux-yocto"

PREFERRED_PROVIDER_virtual/kernel ??= "${XILINX_DEFAULT_KERNEL}"
PREFERRED_VERSION_linux-xlnx ?= "3.14%"
PREFERRED_VERSION_linux-yocto ?= "3.19%"

MACHINE_FEATURES = "usbgadget usbhost vfat ext2 ext3"
MACHINE_FEATURES_BACKFILL_CONSIDERED += "rtc"

IMAGE_BOOT_FILES += "${MACHINE}.dtb"

MACHINE_DEVICETREE := " \
		admxrc7z/admxrc7z-board.dtsi \
		admxrc7z/admxrc7z.dts \
		"
```
